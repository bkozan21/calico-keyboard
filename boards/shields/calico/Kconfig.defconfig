## boards/shields/calico/Kconfig.defconfig
```kconfig
if SHIELD_CALICO_LEFT

config ZMK_KEYBOARD_NAME
    default "calico"

config ZMK_SPLIT_ROLE_CENTRAL
    default y

endif # SHIELD_CALICO_LEFT

if SHIELD_CALICO_LEFT || SHIELD_CALICO_RIGHT

config ZMK_SPLIT
    default y

endif # SHIELD_CALICO_LEFT || SHIELD_CALICO_RIGHT
```

## boards/shields/calico/Kconfig.shield
```kconfig
config SHIELD_CALICO_LEFT
    def_bool $(shields_list_contains,calico_left)

config SHIELD_CALICO_RIGHT
    def_bool $(shields_list_contains,calico_right)
```
